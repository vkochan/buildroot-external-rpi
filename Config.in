## Config.in
```kconfig
menuconfig BR2_EXTERNAL_RPI
	bool "Raspberry Pi External Project"
	default y

	select BR2_PACKAGE_RPI_FIRMWARE

	# Required tools to create the SD image
	select BR2_PACKAGE_HOST_DOSFSTOOLS
	select BR2_PACKAGE_HOST_GENIMAGE
	select BR2_PACKAGE_HOST_MTOOLS

	imply BR2_PACKAGE_RPI_CONSOLE_INIT

if BR2_EXTERNAL_RPI

choice
	prompt "RPi board"

config BR2_RPI_3
	bool "rpi3"

endchoice

config BR2_RPI_BOARD_NAME
	string
	default "rpi3" if BR2_RPI_3

if BR2_TARGET_UBOOT

if BR2_TARGET_UBOOT_BUILD_SYSTEM_KCONFIG
config BR2_TARGET_UBOOT_BOARD_DEFCONFIG
	string
	default "rpi_3_32b" if !BR2_aarch64
	default "rpi_3" if BR2_aarch64
endif

if BR2_TARGET_UBOOT_BUILD_SYSTEM_LEGACY
config BR2_TARGET_UBOOT_BOARDNAME
	string
	default "rpi_3_32b" if !BR2_aarch64
	default "rpi_3" if BR2_aarch64
endif

endif # BR2_TARGET_UBOOT

menu Console

choice
	prompt "UART"

config BR2_RPI_CONSOLE_USE_NORMAL_UART
	bool "normal uart (ttyAMA0)"
	depends on !BR2_RPI_BT_NORMAL

comment "console and bt can't share ttyAMA0 uart"
	depends on BR2_RPI_BT_NORMAL

config BR2_RPI_CONSOLE_USE_MINI_UART
	bool "mini-uart (slow)"
	depends on !BR2_RPI_BT_SLOW

comment "console and bt can't share mini-uart"
	depends on BR2_RPI_BT_NORMAL

endchoice

endmenu

menu Networking

menuconfig BR2_RPI_USE_BT
	bool "Bluetooth"

if BR2_RPI_USE_BT

choice
	prompt "Serial"

config BR2_RPI_BT_NORMAL
	bool "normal bluetooth (ttyAMA0)"
	default y

config BR2_RPI_BT_SLOW
	bool "slow bluetooth (mini-uart)"

endchoice

endif

endmenu # Networking

source "$BR2_EXTERNAL_RPI_PATH/package/Config.in"

endif # BR2_EXTERNAL_RPI
```

## configs/rpi3_defconfig
```kconfig
BR2_arm=y
BR2_cortex_a53=y
BR2_ARM_FPU_NEON_VFPV4=y

# Toolchain
BR2_TOOLCHAIN=y
BR2_TOOLCHAIN_EXTERNAL=y
BR2_TOOLCHAIN_EXTERNAL_CXX=y
BR2_TOOLCHAIN_EXTERNAL_DOWNLOAD=y
BR2_TOOLCHAIN_EXTERNAL_URL="https://github.com/vkochan/toolchain-rpi-arm-4.9.3-linux-gnueabihf/archive/v1.0.tar.gz"
BR2_TOOLCHAIN_EXTERNAL_CUSTOM=y
BR2_TOOLCHAIN_EXTERNAL_CUSTOM_PREFIX="arm-linux-gnueabihf"
BR2_TOOLCHAIN_EXTERNAL_HEADERS_4_1=y
BR2_TOOLCHAIN_EXTERNAL_GCC_4_9=y
BR2_TOOLCHAIN_EXTERNAL_GLIBC=y
BR2_TOOLCHAIN_EXTERNAL_CUSTOM_GLIBC=y
BR2_TOOLCHAIN_EXTERNAL_HAS_SSP=y
BR2_TOOLCHAIN_EXTERNAL_INET_RPC=y

BR2_SYSTEM_DHCP="eth0"

# Linux headers same as kernel, a 4.14 series
BR2_PACKAGE_HOST_LINUX_HEADERS_CUSTOM_4_14=y

BR2_LINUX_KERNEL=y
BR2_LINUX_KERNEL_CUSTOM_TARBALL=y
BR2_LINUX_KERNEL_CUSTOM_TARBALL_LOCATION="$(call github,raspberrypi,linux,83b36f98e1a48d143f0b466fcf9f8c4e382c9a1c)/linux-83b36f98e1a48d143f0b466fcf9f8c4e382c9a1c.tar.gz"
BR2_LINUX_KERNEL_DEFCONFIG="bcm2709"

# Build the DTB from the kernel sources
BR2_LINUX_KERNEL_DTS_SUPPORT=y
BR2_LINUX_KERNEL_INTREE_DTS_NAME="bcm2710-rpi-3-b bcm2710-rpi-3-b-plus bcm2710-rpi-cm3"

# Filesystem / image
BR2_TARGET_ROOTFS_EXT2=y
BR2_TARGET_ROOTFS_EXT2_4=y
BR2_TARGET_ROOTFS_EXT2_SIZE="120M"

BR2_ROOTFS_POST_IMAGE_SCRIPT="$(BR2_EXTERNAL_RPI_PATH)/board/common/post-image.sh"
```

## package/Config.in
```kconfig
menu "Host packages"
	source "$BR2_EXTERNAL_RPI_PATH/package/rpi-image/Config.in"
endmenu

menu "Target packages"

menu "System"
	source "$BR2_EXTERNAL_RPI_PATH/package/rpi-console-init/Config.in"
endmenu

endmenu
```

## toolchain-external/Config.in
```kconfig
source "$BR2_EXTERNAL_RPI_PATH/toolchain-external/toolchain-external-rpi-arm/Config.in"
```

## toolchain/Config.in
```kconfig
menu "Toolchain"

source "$BR2_EXTERNAL_RPI_PATH/toolchain/toolchain-external-rpi-arm/Config.in

endmenu
```

## toolchain/toolchain-external-rpi-arm/Config.in
```kconfig
if BR2_TOOLCHAIN_EXTERNAL

config BR2_TOOLCHAIN_EXTERNAL_RPI_ARM
	bool "Raspberry Pi toolchain"
	depends on BR2_arm
	depends on BR2_ARM_EABIHF
	select BR2_TOOLCHAIN_EXTERNAL_GLIBC
	select BR2_TOOLCHAIN_HAS_SSP
	select BR2_TOOLCHAIN_HAS_NATIVE_RPC
	select BR2_INSTALL_LIBSTDCPP
	select BR2_HOSTARCH_NEEDS_IA32_LIBS
	select BR2_TOOLCHAIN_HEADERS_AT_LEAST_4_1
	select BR2_TOOLCHAIN_GCC_AT_LEAST_4_9

if BR2_TOOLCHAIN_EXTERNAL_RPI_ARM

config BR2_TOOLCHAIN_EXTERNAL_PREFIX
	default "arm-linux-gnueabihf"

config BR2_PACKAGE_PROVIDES_TOOLCHAIN_EXTERNAL
	default "toolchain-external-rpi-arm"

endif

endif
```
